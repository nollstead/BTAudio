## components/audio_board/Kconfig.projbuild
```kconfig
menu "Audio HAL"

choice AUDIO_BOARD
    prompt "Audio board"
    default AUDIO_BOARD_CUSTOM
    help
        Select an audio board to use with the ESP-ADF

config AUDIO_BOARD_CUSTOM
    bool "Custom audio board"

endchoice

choice CUSTOM_BOARD_VERSION
    prompt "Custom board version"
    default CUSTOM_BOARD_V1_0
    depends on AUDIO_BOARD_CUSTOM
    help
        Select your custom board revision

config CUSTOM_BOARD_V1_0
    bool "My Board v1.0"
    help
        Initial board revision with ESP32-WROVER-E-N8R8,
        ES8388 codec, BD37033 audio processor, and dual ADS1115.

endchoice

endmenu
```

## sdkconfig.defaults
```kconfig
##### Bootloader #####
CONFIG_BOOTLOADER_OFFSET_IN_FLASH=0x1000
CONFIG_BOOTLOADER_COMPILER_OPTIMIZATION_SIZE=y

##### FreeRTOS basics #####
CONFIG_FREERTOS_ENABLE_BACKWARD_COMPATIBILITY=y
CONFIG_FREERTOS_HZ=1000

##### Driver noise control #####
# Suppress legacy I2S driver deprecation warning (ADF bundles legacy headers)
CONFIG_I2S_SUPPRESS_DEPRECATE_WARN=y

##### Bluetooth (Classic + SPP + A2DP) #####
# Turn on BT stack (Bluedroid)
CONFIG_BT_ENABLED=y
CONFIG_BT_BLUEDROID_ENABLED=y

# Classic BT (BR/EDR). You can also use BTDM if you later need BLE concurrently.
CONFIG_BT_CLASSIC_ENABLED=y
CONFIG_BTDM_CTRL_MODE_BR_EDR_ONLY=y

# Classic SPP profile (needed for esp_spp_* symbols)
CONFIG_BT_SPP_ENABLED=y

# A2DP playback (sink)
CONFIG_BT_A2DP_ENABLE=y

# Prefer allocating BT buffers in PSRAM to preserve internal DRAM
CONFIG_BT_ALLOCATION_FROM_SPIRAM_FIRST=y

##### PSRAM (external RAM) — REQUIRED for ADF external stacks #####
# Master switch: include PSRAM component
CONFIG_SPIRAM=y

# Initialize PSRAM at boot (you should see "Found 8MB PSRAM..." on boot)
CONFIG_SPIRAM_BOOT_INIT=y

# Make PSRAM available to general malloc(); ADF & BT benefit automatically
CONFIG_SPIRAM_USE_MALLOC=y

# Allow FreeRTOS task stacks in external RAM
CONFIG_FREERTOS_TASK_CREATE_ALLOW_EXT_MEM=y

# Safety/correctness for classic ESP32 PSRAM caching
CONFIG_SPIRAM_CACHE_WORKAROUND=y

# Build one image that still boots if PSRAM is missing (e.g., WROOM)
CONFIG_SPIRAM_IGNORE_NOTFOUND=y

# Keep a small internal reserve for DMA/I2S and critical allocs
# ALWAYSINTERNAL: allocs <= this size always use internal RAM (32 KB)
CONFIG_SPIRAM_MALLOC_ALWAYSINTERNAL=32768
# RESERVE_INTERNAL: keep this much internal RAM free before using PSRAM (64 KB)
CONFIG_SPIRAM_MALLOC_RESERVE_INTERNAL=65536

##### Serial flasher config (8MB flash for WROVER-E-N8R8) #####
CONFIG_ESPTOOLPY_FLASHSIZE_8MB=y
CONFIG_ESPTOOLPY_HEADER_FLASHSIZE_UPDATE=y
CONFIG_ESPTOOLPY_BEFORE_RESET=y

##### Partition Table (use your CSV; offsets auto-placed) #####
CONFIG_PARTITION_TABLE_CUSTOM=y
CONFIG_PARTITION_TABLE_CUSTOM_FILENAME="partitions.csv"
CONFIG_PARTITION_TABLE_FILENAME="partitions.csv"
CONFIG_PARTITION_TABLE_MD5=y

# Suppress legacy driver deprecation warnings (ADF uses legacy APIs)
CONFIG_I2S_SUPPRESS_DEPRECATE_WARN=y
CONFIG_ADC_SUPPRESS_DEPRECATE_WARN=y
CONFIG_TOUCH_SUPPRESS_DEPRECATE_WARN=y
CONFIG_RMT_SUPPRESS_DEPRECATE_WARN=y
CONFIG_PCNT_SUPPRESS_DEPRECATE_WARN=y
CONFIG_GPTIMER_SUPPRESS_DEPRECATE_WARN=y
```
